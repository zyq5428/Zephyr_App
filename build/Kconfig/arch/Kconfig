## build/Kconfig/arch/Kconfig
```kconfig
# Load Zephyr Arch Kconfig descriptions.
osource "E:/zephyrproject/zephyr/arch/rx/Kconfig"
osource "E:/zephyrproject/zephyr/arch/x86/Kconfig"
osource "E:/zephyrproject/zephyr/arch/xtensa/Kconfig"
osource "E:/zephyrproject/zephyr/arch/sparc/Kconfig"
osource "E:/zephyrproject/zephyr/arch/riscv/Kconfig"
osource "E:/zephyrproject/zephyr/arch/posix/Kconfig"
osource "E:/zephyrproject/zephyr/arch/mips/Kconfig"
osource "E:/zephyrproject/zephyr/arch/arm64/Kconfig"
osource "E:/zephyrproject/zephyr/arch/arm/Kconfig"
osource "E:/zephyrproject/zephyr/arch/arc/Kconfig"
```

## build/Kconfig/boards/Kconfig
```kconfig
# Load Zephyr board Kconfig descriptions.
osource "E:/zephyrproject/zephyr/boards/alientek/pandora_stm32l475/Kconfig"
```

## build/Kconfig/boards/Kconfig.defconfig
```kconfig
# Load Zephyr board defconfig descriptions.
osource "E:/zephyrproject/zephyr/boards/alientek/pandora_stm32l475/Kconfig.defconfig"
```

## build/Kconfig/boards/Kconfig.pandora_stm32l475
```kconfig
# Load board Kconfig descriptions.
osource "E:/zephyrproject/zephyr/boards/alientek/pandora_stm32l475/Kconfig.pandora_stm32l475"
```

## build/Kconfig/boards/Kconfig.sysbuild
```kconfig
# Load Sysbuild board Kconfig descriptions.
osource "E:/zephyrproject/zephyr/boards/alientek/pandora_stm32l475/Kconfig.sysbuild"
```

## build/Kconfig/soc/Kconfig
```kconfig
# Load Zephyr SoC Kconfig descriptions.
osource "E:/zephyrproject/zephyr/soc/xlnx/zynqmp/Kconfig"
osource "E:/zephyrproject/zephyr/soc/xlnx/zynq7000/Kconfig"
osource "E:/zephyrproject/zephyr/soc/xlnx/versalnet/Kconfig"
osource "E:/zephyrproject/zephyr/soc/xlnx/versal2/Kconfig"
osource "E:/zephyrproject/zephyr/soc/xen/Kconfig"
osource "E:/zephyrproject/zephyr/soc/wch/ch32v/Kconfig"
osource "E:/zephyrproject/zephyr/soc/ti/simplelink/Kconfig"
osource "E:/zephyrproject/zephyr/soc/ti/mspm0/Kconfig"
osource "E:/zephyrproject/zephyr/soc/ti/lm3s6965/Kconfig"
osource "E:/zephyrproject/zephyr/soc/ti/k3/Kconfig"
osource "E:/zephyrproject/zephyr/soc/telink/tlsr/Kconfig"
osource "E:/zephyrproject/zephyr/soc/starfive/jh71xx/Kconfig"
osource "E:/zephyrproject/zephyr/soc/st/stm32/Kconfig"
osource "E:/zephyrproject/zephyr/soc/snps/qemu_arc/Kconfig"
osource "E:/zephyrproject/zephyr/soc/snps/nsim/arc_v/Kconfig"
osource "E:/zephyrproject/zephyr/soc/snps/nsim/arc_classic/Kconfig"
osource "E:/zephyrproject/zephyr/soc/snps/hsdk4xd/Kconfig"
osource "E:/zephyrproject/zephyr/soc/snps/hsdk/Kconfig"
osource "E:/zephyrproject/zephyr/soc/snps/emsk/Kconfig"
osource "E:/zephyrproject/zephyr/soc/snps/emsdp/Kconfig"
osource "E:/zephyrproject/zephyr/soc/snps/arc_iot/Kconfig"
osource "E:/zephyrproject/zephyr/soc/silabs/Kconfig"
osource "E:/zephyrproject/zephyr/soc/sifli/sf32/Kconfig"
osource "E:/zephyrproject/zephyr/soc/sifive/sifive_freedom/Kconfig"
osource "E:/zephyrproject/zephyr/soc/sensry/Kconfig"
osource "E:/zephyrproject/zephyr/soc/rockchip/Kconfig"
osource "E:/zephyrproject/zephyr/soc/renode/riscv_virtual/Kconfig"
osource "E:/zephyrproject/zephyr/soc/renode/cortex_r8_virtual/Kconfig"
osource "E:/zephyrproject/zephyr/soc/renesas/smartbond/Kconfig"
osource "E:/zephyrproject/zephyr/soc/renesas/rz/Kconfig"
osource "E:/zephyrproject/zephyr/soc/renesas/rx/Kconfig"
osource "E:/zephyrproject/zephyr/soc/renesas/rcar/Kconfig"
osource "E:/zephyrproject/zephyr/soc/renesas/ra/Kconfig"
osource "E:/zephyrproject/zephyr/soc/realtek/ec/Kconfig"
osource "E:/zephyrproject/zephyr/soc/raspberrypi/rpi_pico/Kconfig"
osource "E:/zephyrproject/zephyr/soc/quicklogic/eos_s3/Kconfig"
osource "E:/zephyrproject/zephyr/soc/qemu/virt_riscv/Kconfig"
osource "E:/zephyrproject/zephyr/soc/qemu/malta/Kconfig"
osource "E:/zephyrproject/zephyr/soc/openisa/rv32m1/Kconfig"
osource "E:/zephyrproject/zephyr/soc/openhwgroup/cva6/Kconfig"
osource "E:/zephyrproject/zephyr/soc/oct/osd32mp15x/Kconfig"
osource "E:/zephyrproject/zephyr/soc/nxp/s32/Kconfig"
osource "E:/zephyrproject/zephyr/soc/nxp/rw/Kconfig"
osource "E:/zephyrproject/zephyr/soc/nxp/mcx/Kconfig"
osource "E:/zephyrproject/zephyr/soc/nxp/lpc/Kconfig"
osource "E:/zephyrproject/zephyr/soc/nxp/layerscape/Kconfig"
osource "E:/zephyrproject/zephyr/soc/nxp/kinetis/Kconfig"
osource "E:/zephyrproject/zephyr/soc/nxp/imxrt/Kconfig"
osource "E:/zephyrproject/zephyr/soc/nxp/imx/Kconfig"
osource "E:/zephyrproject/zephyr/soc/nuvoton/numicro/Kconfig"
osource "E:/zephyrproject/zephyr/soc/nuvoton/numaker/Kconfig"
osource "E:/zephyrproject/zephyr/soc/nuvoton/npcx/Kconfig"
osource "E:/zephyrproject/zephyr/soc/nuvoton/npcm/Kconfig"
osource "E:/zephyrproject/zephyr/soc/nordic/Kconfig"
osource "E:/zephyrproject/zephyr/soc/neorv32/Kconfig"
osource "E:/zephyrproject/zephyr/soc/native/inf_clock/Kconfig"
osource "E:/zephyrproject/zephyr/soc/microchip/sam/Kconfig"
osource "E:/zephyrproject/zephyr/soc/microchip/sam/sama7/Kconfig"
osource "E:/zephyrproject/zephyr/soc/microchip/sam/sam_d5x_e5x/Kconfig"
osource "E:/zephyrproject/zephyr/soc/microchip/pic32c/pic32cz_ca/Kconfig"
osource "E:/zephyrproject/zephyr/soc/microchip/pic32c/pic32cx_sg/Kconfig"
osource "E:/zephyrproject/zephyr/soc/microchip/pic32c/pic32cm_jh/Kconfig"
osource "E:/zephyrproject/zephyr/soc/microchip/miv/Kconfig"
osource "E:/zephyrproject/zephyr/soc/microchip/mec/Kconfig"
osource "E:/zephyrproject/zephyr/soc/mediatek/mt8xxx/Kconfig"
osource "E:/zephyrproject/zephyr/soc/lowrisc/opentitan/Kconfig"
osource "E:/zephyrproject/zephyr/soc/litex/litex_vexriscv/Kconfig"
osource "E:/zephyrproject/zephyr/soc/ite/ec/Kconfig"
osource "E:/zephyrproject/zephyr/soc/intel/raptor_lake/Kconfig"
osource "E:/zephyrproject/zephyr/soc/intel/panther_lake/Kconfig"
osource "E:/zephyrproject/zephyr/soc/intel/lakemont/Kconfig"
osource "E:/zephyrproject/zephyr/soc/intel/intel_socfpga_std/Kconfig"
osource "E:/zephyrproject/zephyr/soc/intel/intel_socfpga/Kconfig"
osource "E:/zephyrproject/zephyr/soc/intel/intel_niosv/Kconfig"
osource "E:/zephyrproject/zephyr/soc/intel/intel_ish/Kconfig"
osource "E:/zephyrproject/zephyr/soc/intel/intel_adsp/Kconfig"
osource "E:/zephyrproject/zephyr/soc/intel/elkhart_lake/Kconfig"
osource "E:/zephyrproject/zephyr/soc/intel/atom/Kconfig"
osource "E:/zephyrproject/zephyr/soc/intel/apollo_lake/Kconfig"
osource "E:/zephyrproject/zephyr/soc/intel/alder_lake/Kconfig"
osource "E:/zephyrproject/zephyr/soc/infineon/edge/Kconfig"
osource "E:/zephyrproject/zephyr/soc/infineon/cat3/Kconfig"
osource "E:/zephyrproject/zephyr/soc/infineon/cat1c/Kconfig"
osource "E:/zephyrproject/zephyr/soc/infineon/cat1b/Kconfig"
osource "E:/zephyrproject/zephyr/soc/infineon/cat1a/Kconfig"
osource "E:/zephyrproject/zephyr/soc/gd/gd32/Kconfig"
osource "E:/zephyrproject/zephyr/soc/gaisler/leon3/Kconfig"
osource "E:/zephyrproject/zephyr/soc/gaisler/gr716a/Kconfig"
osource "E:/zephyrproject/zephyr/soc/espressif/Kconfig"
osource "E:/zephyrproject/zephyr/soc/ene/kb1200/Kconfig"
osource "E:/zephyrproject/zephyr/soc/ene/kb106x/Kconfig"
osource "E:/zephyrproject/zephyr/soc/egis/Kconfig"
osource "E:/zephyrproject/zephyr/soc/efinix/sapphire/Kconfig"
osource "E:/zephyrproject/zephyr/soc/cdns/xtensa_sample_controller/Kconfig"
osource "E:/zephyrproject/zephyr/soc/cdns/sample_controller32/Kconfig"
osource "E:/zephyrproject/zephyr/soc/cdns/dc233c/Kconfig"
osource "E:/zephyrproject/zephyr/soc/brcm/bcmvk/Kconfig"
osource "E:/zephyrproject/zephyr/soc/brcm/bcm2712/Kconfig"
osource "E:/zephyrproject/zephyr/soc/brcm/bcm2711/Kconfig"
osource "E:/zephyrproject/zephyr/soc/bflb/Kconfig"
osource "E:/zephyrproject/zephyr/soc/atmel/sam0/Kconfig"
osource "E:/zephyrproject/zephyr/soc/atmel/sam/Kconfig"
osource "E:/zephyrproject/zephyr/soc/aspeed/Kconfig"
osource "E:/zephyrproject/zephyr/soc/arm/Kconfig"
osource "E:/zephyrproject/zephyr/soc/arm/beetle/Kconfig"
osource "E:/zephyrproject/zephyr/soc/antmicro/myra/Kconfig"
osource "E:/zephyrproject/zephyr/soc/andestech/Kconfig"
osource "E:/zephyrproject/zephyr/soc/amd/acp_6_0/Kconfig"
osource "E:/zephyrproject/zephyr/soc/ambiq/Kconfig"
osource "E:/zephyrproject/zephyr/soc/aesc/Kconfig"
osource "E:/zephyrproject/zephyr/soc/adi/max32/Kconfig"
```
